#include "oled.h"
#include <stdio.h>
#include <string.h>

/*===========================================================================
 * OLED_F8x16 字模库 — 来自参考项目，宽8像素×高16像素
 *===========================================================================*/
const uint8_t OLED_F8x16[][16] =
{
    0x00,0x00,0x00,0x00,0x00,0x00,0x00,0x00,
    0x00,0x00,0x00,0x00,0x00,0x00,0x00,0x00,//  0

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    0x00,0x00,0x00,0x00,0x00,0x00,0x00,0x00,//~ 94
};

/*===========================================================================
 * 底层 I2C 通信（硬件 I2C）
 *===========================================================================*/

static void OLED_WriteCommand(uint8_t Command)
{
    uint8_t buf[2] = {0x00, Command};
    HAL_I2C_Master_Transmit(&hi2c1, OLED_ADDR << 1, buf, 2, 1000);
}

static void OLED_WriteData(uint8_t Data)
{
    uint8_t buf[2] = {0x40, Data};
    HAL_I2C_Master_Transmit(&hi2c1, OLED_ADDR << 1, buf, 2, 1000);
}

/*===========================================================================
 * 光标设置
 *===========================================================================*/
static void OLED_SetCursor(uint8_t Y, uint8_t X)
{
    OLED_WriteCommand(0xB0 | Y);                    // 设置Y位置（页地址 0~7）
    OLED_WriteCommand(0x10 | ((X & 0xF0) >> 4));    // 设置X位置高4位
    OLED_WriteCommand(0x00 | (X & 0x0F));            // 设置X位置低4位
}

/*===========================================================================
 * OLED 初始化（初始化序列与参考项目一致）
 *===========================================================================*/
void OLED_Init(void)
{
    HAL_Delay(100);                  // 等待OLED上电稳定

    OLED_WriteCommand(0xAE);         // 关闭显示

    OLED_WriteCommand(0xD5);         // 设置显示时钟分频比/振荡器频率
    OLED_WriteCommand(0x80);

    OLED_WriteCommand(0xA8);         // 设置多路复用率
    OLED_WriteCommand(0x3F);

    OLED_WriteCommand(0xD3);         // 设置显示偏移
    OLED_WriteCommand(0x00);

    OLED_WriteCommand(0x40);         // 设置显示开始行

    OLED_WriteCommand(0xA1);         // 设置左右方向（0xA1正常, 0xA0左右反置）

    OLED_WriteCommand(0xC8);         // 设置上下方向（0xC8正常, 0xC0上下反置）

    OLED_WriteCommand(0xDA);         // 设置COM引脚硬件配置
    OLED_WriteCommand(0x12);

    OLED_WriteCommand(0x81);         // 设置对比度
    OLED_WriteCommand(0xCF);

    OLED_WriteCommand(0xD9);         // 设置预充电周期
    OLED_WriteCommand(0xF1);

    OLED_WriteCommand(0xDB);         // 设置VCOMH取消选择级别
    OLED_WriteCommand(0x30);

    OLED_WriteCommand(0xA4);         // 全局显示开启

    OLED_WriteCommand(0xA6);         // 正常显示（非反相）

    OLED_WriteCommand(0x8D);         // 开启电荷泵
    OLED_WriteCommand(0x14);

    OLED_WriteCommand(0xAF);         // 开启显示

    OLED_Clear();
}

/*===========================================================================
 * 清屏
 *===========================================================================*/
void OLED_Clear(void)
{
    uint8_t i, j;
    for (j = 0; j < 8; j++)
    {
        OLED_SetCursor(j, 0);
        for (i = 0; i < 128; i++)
        {
            OLED_WriteData(0x00);
        }
    }
}

/*===========================================================================
 * 显示一个 8x16 字符
 *   Line   : 行位置，范围 1~4
 *   Column : 列位置，范围 1~16
 *===========================================================================*/
void OLED_ShowChar(uint8_t Line, uint8_t Column, char Char)
{
    uint8_t i;

    OLED_SetCursor((Line - 1) * 2, (Column - 1) * 8);         // 设置光标：上半部分
    for (i = 0; i < 8; i++)
    {
        OLED_WriteData(OLED_F8x16[Char - ' '][i]);             // 显示上半
    }

    OLED_SetCursor((Line - 1) * 2 + 1, (Column - 1) * 8);     // 设置光标：下半部分
    for (i = 0; i < 8; i++)
    {
        OLED_WriteData(OLED_F8x16[Char - ' '][i + 8]);         // 显示下半
    }
}

/*===========================================================================
 * 显示字符串
 *===========================================================================*/
void OLED_ShowString(uint8_t Line, uint8_t Column, char *String)
{
    uint8_t i;
    for (i = 0; String[i] != '\0'; i++)
    {
        OLED_ShowChar(Line, Column + i, String[i]);
    }
}

/*===========================================================================
 * 次方函数（用于数字显示）
 *===========================================================================*/
static uint32_t OLED_Pow(uint32_t X, uint32_t Y)
{
    uint32_t Result = 1;
    while (Y--)
    {
        Result *= X;
    }
    return Result;
}

/*===========================================================================
 * 显示无符号整数
 *===========================================================================*/
void OLED_ShowNum(uint8_t Line, uint8_t Column, uint32_t Number, uint8_t Length)
{
    uint8_t i;
    for (i = 0; i < Length; i++)
    {
        OLED_ShowChar(Line, Column + i, Number / OLED_Pow(10, Length - i - 1) % 10 + '0');
    }
}

/*===========================================================================
 * 显示有符号整数
 *===========================================================================*/
void OLED_ShowSignedNum(uint8_t Line, uint8_t Column, int32_t Number, uint8_t Length)
{
    uint8_t i;
    uint32_t Number1;
    if (Number >= 0)
    {
        OLED_ShowChar(Line, Column, '+');
        Number1 = Number;
    }
    else
    {
        OLED_ShowChar(Line, Column, '-');
        Number1 = -Number;
    }
    for (i = 0; i < Length; i++)
    {
        OLED_ShowChar(Line, Column + i + 1, Number1 / OLED_Pow(10, Length - i - 1) % 10 + '0');
    }
}

/*===========================================================================
 * 显示浮点数
 *   例如 OLED_ShowFloat(2, 1, 25.68f, 2, 2) → "25.68"
 *===========================================================================*/
void OLED_ShowFloat(uint8_t Line, uint8_t Column, float Num, uint8_t IntLen, uint8_t DecLen)
{
    uint8_t i;
    int32_t intPart, decPart;

    /* 处理负数 */
    if (Num < 0)
    {
        OLED_ShowChar(Line, Column, '-');
        Num = -Num;
        Column++;
    }

    /* 整数部分 */
    intPart = (int32_t)Num;

    /* 小数部分 */
    decPart = 1;
    for (i = 0; i < DecLen; i++)
        decPart *= 10;
    decPart = (int32_t)((Num - intPart) * decPart + 0.5f);

    /* 显示整数部分 */
    OLED_ShowNum(Line, Column, intPart, IntLen);
    Column += IntLen;

    /* 显示小数点 */
    if (DecLen > 0)
    {
        OLED_ShowChar(Line, Column, '.');
        Column++;

        /* 显示小数部分 */
        for (i = 0; i < DecLen; i++)
        {
            OLED_ShowChar(Line, Column + i, decPart / OLED_Pow(10, DecLen - i - 1) % 10 + '0');
        }
    }
}
